
#include <main.h>
#include "E:\file Keil C\AT89S52\library\delay.h"
#include<stdlib.h>
unsigned char code  mang1[]={	
								0,0,0,0,0, 0,0,0,0,0,	   //13
								254, 146, 146, 68, 56, 0,     //Р
								248, 20, 18, 20, 248, 0,      //A
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								0,0,0,0,0, 0,0,0,0,0, 0,0,0,0,0,0
							};	
						  
unsigned int i,k=0;
unsigned char j,buoc=0;
void ngat_timer0(void) interrupt 1 using 1
{
	P0_1=~P0_1;
	TH0=0xFD;
	TL0=0x12;
}
void ISR0 (void) interrupt 0 using 2
{	  
	TH0=0xFD;
	TL0=0x12;
	TR0=1;
	P0_1=0;
	switch (buoc)
	{	  
//================================================================================================
		case 0:	  
			  
				for(i=0;i<120;i++)
				{
					j=25;
					while(j--)
					{
					P1=~mang1[i];
					}
					
				}
			//	P1=0xff;
		k++;
		if(k==200)
		{ 
		k=0;
		buoc++;									// dung de hien thi ma code khac
		}
		break;	

//=======================================================================================
		default:
			{buoc=0;
			k=0;}
		break;	
	}
}  

void main()
{
TMOD=1;
P1=0xff;
P0=0xff;
EA=1;
EX0=1;
ET0=1;
while(1)
{ 
delay(1000);
}
} 